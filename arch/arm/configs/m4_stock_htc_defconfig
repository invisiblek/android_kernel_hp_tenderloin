## arch/arm/mach-msm/hp/Kconfig
```kconfig
config MACH_HP
	bool
	select FB_MSM_LCDC
	select FB_MSM_MIPI_DSI

menu "HP Board Selection"
source "arch/arm/mach-msm/hp/Kconfig.board"
endmenu
```

## arch/arm/mach-msm/hp/Kconfig.board
```kconfig
#
# Include the specific Kconfig file for HP board
#

# TENDERLOIN
source "arch/arm/mach-msm/hp/tenderloin/Kconfig"

config MACH_HP_DUMMY
       depends on MACH_HP
       bool "NONE (No device)"
```

## arch/arm/mach-msm/hp/Kconfig.offsets
```kconfig
config PHYS_OFFSET
	hex
	default "0x40200000" if MACH_TENDERLOIN
	default "0x10000000"
```

## arch/arm/mach-msm/hp/tenderloin/Kconfig
```kconfig
config MACH_TENDERLOIN
	depends on ARCH_MSM8X60
	select MACH_HP
	select SND_SOC_WM8994
	select MSM_INSECURE_PIL_QDSP6V3
        select REMOVE_SMI_2X_CLK
	bool "HP Tenderloin"
	help
	  Support for the HTC TENDERLOIN device.
```

## arch/arm/mach-msm/htc/Kconfig
```kconfig
config MACH_HTC
	bool
	select FB_MSM_MIPI_DSI

menu "HTC Board Selection"
source "arch/arm/mach-msm/htc/Kconfig.board"
endmenu


menu "HTC Specific Patches"

config HTC_BATT_ALARM
	bool "Enable 3.0V device shutdown mechanism"
	depends on HAS_EARLYSUSPEND
	default n
	help
	  Enable 3.0V triggeer level 0 shutdown rule

config HTC_BATT_CORE
	depends on POWER_SUPPLY
	default n
	bool "HTC battery core driver"

config HTC_BATT_8x60
	depends on HTC_BATT_CORE
	default n
	bool "HTC battery driver for 8x60"

config HTC_BATT_8960
	depends on HTC_BATT_CORE
	default n
	bool "HTC battery driver for MSM8960"

config HTC_CLK_CTRL
	depends on ARCH_MSM8X60
	default n
	bool "HTC Fast/Sleep Clk Support"

config HTC_HEADSET_MGR
	tristate "HTC headset manager driver"
	default n
	help
	  Provides support for HTC headset manager.

config HTC_HEADSET_MISC
	tristate "HTC MISC headset detection driver"
	depends on HTC_HEADSET_MGR
	default n
	help
	  Provides support of HTC MISC headset detection.

config HTC_HEADSET_PMIC
	tristate "HTC PMIC headset detection driver"
	depends on HTC_HEADSET_MGR
	default n
	help
	  Provides support for HTC PMIC headset detection.

config HTC_HEADSET_ONE_WIRE
	tristate "HTC 1-wire headset detection driver"
	depends on HTC_HEADSET_MGR
	default n
	help
	  Provides support for HTC 1-wire headset detection.

config HTC_HEADSET_GPIO
	tristate "HTC GPIO headset detection driver"
	depends on HTC_HEADSET_MGR
	default n
	help
	  Provides support of HTC GPIO headset detection.

config HTC_HEADSET_8X60
	tristate "HTC 8X60 headset detection driver"
	depends on HTC_HEADSET_MGR && ARCH_MSM8X60
	default n
	help
	  Provides support of HTC 8X60 headset detection.

config HTC_WAKE_ON_VOL
	bool "Enable wake-on-volume support"
	default y

config HTC_HEADSET_GPIO
	tristate "HTC GPIO headset detection driver"
	depends on HTC_HEADSET_MGR
	default n
	help
	  Provides support for HTC GPIO headset detection.

config HTC_SIMLOCK
	bool "Enable simlock support"
	depends on ARCH_MSM8X60
	default n

config FORCE_FAST_CHARGE
	bool "Force AC charge mode at will"
	depends on ARCH_MSM8X60
	default n
	help
	  A simple sysfs interface to force adapters that
	  are detected as USB to charge as AC.

endmenu
```

## arch/arm/mach-msm/htc/Kconfig.board
```kconfig
#
# Include the specific Kconfig file for HTC board
#

# ELITE
source "arch/arm/mach-msm/htc/elite/Kconfig"

# FIGHTER
source "arch/arm/mach-msm/htc/fighter/Kconfig"

# JET
source "arch/arm/mach-msm/htc/jet/Kconfig"

# VILLE
source "arch/arm/mach-msm/htc/ville/Kconfig"

# TC2
source "arch/arm/mach-msm/htc/tc2/Kconfig"

# OPERAUL
source "arch/arm/mach-msm/htc/operaul/Kconfig"

# M4_UL
source "arch/arm/mach-msm/htc/m4ul/Kconfig"

# PYRAMID
source "arch/arm/mach-msm/htc/pyramid/Kconfig"

# VISION
source "arch/arm/mach-msm/htc/vision/Kconfig"

# M7_UL
source "arch/arm/mach-msm/htc/m7ul/Kconfig"

config MACH_HTC_DUMMY
       depends on MACH_HTC
       bool "NONE (No device)"
```

## arch/arm/mach-msm/htc/Kconfig.offsets
```kconfig
config PHYS_OFFSET
	hex
	default "0x80400000" if ARCH_MSM8930 && !MACH_M4_UL
	default "0x80600000" if ARCH_MSM8930 && MACH_M4_UL
	default "0x80400000" if ARCH_MSM8960 && !ARCH_MSM8930
	default "0x10000000"
```

## arch/arm/mach-msm/htc/m4ul/Kconfig
```kconfig
config BOARD_HEADER_FILE
	string "HTC board specific header file name"
	default ""

config MACH_M4_UL
	depends on ARCH_MSM8930
	select MACH_HTC
	bool "HTC One Mini"
	help
	  Support for the HTC One Mini device.
```

## arch/arm/mach-msm/htc/operaul/Kconfig
```kconfig
config BOARD_HEADER_FILE
	string "HTC board specific header file name"
	default ""

config MACH_OPERAUL
	depends on ARCH_MSM8930
	select MACH_HTC
	bool "HTC First"
	help
	  Support for the HTC First device.
```

## arch/arm/mach-msm/htc/pyramid/Kconfig
```kconfig
config BOARD_HEADER_FILE
	string "HTC board specific header file name"
	default ""

config MACH_PYRAMID
	depends on ARCH_MSM8X60
	select MACH_HTC
        select REMOVE_SMI_2X_CLK
	bool "HTC Pyramid"
	help
	  Support for the HTC PYRAMID device.
```

## arch/arm/mach-msm/htc/ruby/Kconfig
```kconfig
config BOARD_HEADER_FILE
	string "HTC board specific header file name"
	default ""

config MACH_RUBY
	depends on ARCH_MSM8X60
	select MACH_HTC
	select REMOVE_SMI_2X_CLK
	bool "HTC Ruby"
	help
	  Support for the HTC RUBY device.
```

## arch/arm/mach-msm/htc/shooter/Kconfig
```kconfig
config BOARD_HEADER_FILE
	string "HTC board specific header file name"
	default ""

config MACH_SHOOTER
	depends on ARCH_MSM8X60
	select MACH_HTC
        select REMOVE_SMI_2X_CLK
	bool "HTC Shooter"
	help
	  Support for the HTC SHOOTER device.
```

## arch/arm/mach-msm/htc/tc2/Kconfig
```kconfig
config BOARD_HEADER_FILE
	string "HTC board specific header file name"
	default ""

config MACH_TC2
	depends on ARCH_MSM8930
	select MACH_HTC
	bool "HTC One VX"
	help
	  Support for the HTC One VX device.
```

## arch/arm/mach-msm/htc/totemc2/Kconfig
```kconfig
config BOARD_HEADER_FILE
	string "HTC board specific header file name"
	default ""

config MACH_TC2
	depends on ARCH_MSM8930 && ARCH_MSM8960
	select MACH_HTC
	bool "HTC Elite"
	help
	  Support for the HTC ELITE device.
```

## arch/arm/mach-msm/htc/vision/Kconfig
```kconfig
config MACH_VISION
	depends on ARCH_MSM7X30
	select MACH_HTC
        select REMOVE_EBI1_FIXED_CLK
	bool "HTC Vision"
	help
	  Support for the HTC VISION device.
```
